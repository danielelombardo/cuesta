## boards/shields/altiplano/Kconfig.defconfig
```kconfig
if SHIELD_ALTIPLANO

config ZMK_KEYBOARD_NAME
	default "altiplano"

config ZMK_USB
    default y

config ZMK_POINTING
    default y
    
endif
```

## boards/shields/brut/Kconfig.shield
```kconfig
config SHIELD_BRUT
	def_bool $(shields_list_contains,brut)
config SHIELD_BRUT_DONGLE
	def_bool $(shields_list_contains,brut_dongle)
```

## boards/shields/cuesta/Kconfig.defconfig
```kconfig
if SHIELD_CUESTA_DONGLE

config ZMK_KEYBOARD_NAME
	default "cuesta"
	
config ZMK_SPLIT_ROLE_CENTRAL
	default y

config ZMK_USB
    default y
	
endif


if SHIELD_CUESTA_LEFT || SHIELD_CUESTA_RIGHT || SHIELD_CUESTA_DONGLE 

config ZMK_SPLIT
	default y

config ZMK_POINTING
    default y
    
config ZMK_SLEEP
    default y

endif
```

## boards/shields/foxyduck/Kconfig.defconfig
```kconfig
if SHIELD_FOXYDUCK

config ZMK_KEYBOARD_NAME
	default "foxyduck"

config ZMK_USB
    default y

config ZMK_POINTING
    default y
    
endif
```

## boards/shields/laut/Kconfig.shield
```kconfig
config SHIELD_LAUT
	def_bool $(shields_list_contains,laut)
config SHIELD_LAUT_DONGLE
	def_bool $(shields_list_contains,laut_dongle)
```

## boards/shields/sosuke/Kconfig.defconfig
```kconfig
if SHIELD_SOSUKE_DONGLE

config ZMK_KEYBOARD_NAME
	default "sosuke"

config ZMK_SPLIT_ROLE_CENTRAL
	default y

config ZMK_USB
    default y

endif

if SHIELD_SOSUKE_DONGLE || SHIELD_SOSUKE
    
config ZMK_SPLIT
    default y

config ZMK_POINTING
    default y
    
config ZMK_SLEEP
    default y

endif
```

## boards/shields/sosuke/Kconfig.shield
```kconfig
config SHIELD_SOSUKE
	def_bool $(shields_list_contains,sosuke)
config SHIELD_SOSUKE_DONGLE
	def_bool $(shields_list_contains,sosuke_dongle)
```

## boards/shields/zukuma/Kconfig.defconfig
```kconfig
if SHIELD_ZUKUMA_DONGLE

config ZMK_KEYBOARD_NAME
	default "zukuma"

config ZMK_SPLIT_ROLE_CENTRAL
    default y

# Set this to the number of peripherals your dongle will have.
# For a unibody, this would be 1. If you have left and right halves, set it to 2, etc.
config ZMK_SPLIT_BLE_CENTRAL_PERIPHERALS
    default 1

endif

if SHIELD_ZUKUMA || SHIELD_ZUKUMA_DONGLE

config ZMK_SPLIT_BLE
    default y

config ZMK_POINTING
    default y
    
config ZMK_SLEEP
    default y

endif
```

## boards/shields/zukuma/Kconfig.shield
```kconfig
config SHIELD_ZUKUMA
	def_bool $(shields_list_contains,zukuma)
config SHIELD_ZUKUMA_DONGLE
	def_bool $(shields_list_contains,zukuma_dongle)
```

## config/boards/shields/cuesta/Kconfig.defconfig
```kconfig
if SHIELD_CUESTA_DONGLE

config ZMK_KEYBOARD_NAME
	default "cuesta"
	
config ZMK_SPLIT_ROLE_CENTRAL
	default y

config ZMK_SPLIT_BLE_CENTRAL_PERIPHERALS
    default 2

config ZMK_SPLIT_BLE_CENTRAL_BATTERY_LEVEL_FETCHING
    default y

config ZMK_SPLIT_BLE_CENTRAL_BATTERY_LEVEL_PROXY
    default y

config ZMK_USB
    default y
	
endif


if SHIELD_CUESTA_LEFT || SHIELD_CUESTA_RIGHT || SHIELD_CUESTA_DONGLE 

config ZMK_SPLIT
	default y

config ZMK_POINTING
    default y
    
config ZMK_SLEEP
    default y
    	
endif
```

## config/boards/shields/cuesta/Kconfig.shield
```kconfig
config SHIELD_CUESTA_LEFT
	def_bool $(shields_list_contains,cuesta_left)

config SHIELD_CUESTA_RIGHT
	def_bool $(shields_list_contains,cuesta_right)

config SHIELD_CUESTA_DONGLE
	def_bool $(shields_list_contains,cuesta_dongle)
```
